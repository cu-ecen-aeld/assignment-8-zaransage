## conf/local.conf
```bitbake
MACHINE = "qemuarm64"
TEMPLATECONF=../meta-poky/conf
DL_DIR ?= "/home/dmarble/git/assignment-6-zaransage/build/downloads"
SSTATE_DIR ?= "/home/dmarble/git/assignment-6-zaransage/build/sstate-cache"
```
